## atomisp/6.10/drivers/Kconfig
```kconfig
# SPDX-License-Identifier: GPL-2.0
menu "Device Drivers"

source "drivers/media/Kconfig"
source "drivers/staging/Kconfig"
source "drivers/platform/Kconfig"

endmenu
```

## atomisp/6.10/drivers/media/pci/Kconfig
```kconfig
# SPDX-License-Identifier: GPL-2.0-only

if PCI

menuconfig MEDIA_PCI_SUPPORT
	bool "Media PCI Adapters"
	help
	  Enable media drivers for PCI/PCIe bus.
	  If you have such devices, say Y.

if MEDIA_PCI_SUPPORT

source "drivers/media/pci/intel/Kconfig"

endif #MEDIA_PCI_SUPPORT
endif #PCI
```

## atomisp/6.10/drivers/platform/x86/intel/Kconfig
```kconfig
# SPDX-License-Identifier: GPL-2.0-only
#
# Intel x86 Platform Specific Drivers
#

source "drivers/platform/x86/intel/atomisp2/Kconfig"
source "drivers/platform/x86/intel/wmi/Kconfig"

config INTEL_BYTCRC_PWRSRC
	tristate "Intel Bay Trail Crystal Cove power source driver"
	depends on INTEL_SOC_PMIC
	help
	  This option adds a power source driver for Crystal Cove PMICs
	  on Intel Bay Trail devices.

	  To compile this driver as a module, choose M here: the module
	  will be called intel_bytcrc_pwrsrc.

config INTEL_ISHTP_ECLITE
	tristate "Intel ISHTP eclite controller Driver"
	depends on INTEL_ISH_HID
	depends on ACPI
	help
	  This driver is for accessing the PSE (Programmable Service Engine) -
	  an Embedded Controller like IP - using ISHTP (Integrated Sensor Hub
	  Transport Protocol) to get battery, thermal and UCSI (USB Type-C
	  Connector System Software Interface) related data from the platform.
	  Users who don't want to use discrete Embedded Controller on Intel's
	  Elkhartlake platform can leverage this integrated solution of
	  ECLite which is part of PSE subsystem.

	  To compile this driver as a module, choose M here: the module
	  will be called intel_ishtp_eclite.
```

## atomisp/6.11/Kconfig
```kconfig
# SPDX-License-Identifier: GPL-2.0
menu "Device Drivers"

source "arch/x86/Kconfig"
source "drivers/media/Kconfig"

endmenu
```

## atomisp/6.11/arch/x86/Kconfig
```kconfig
# SPDX-License-Identifier: GPL-2.0

config PUNIT_ATOM_DEBUG
	tristate "ATOM Punit debug driver"
	depends on PCI
	select DEBUG_FS
	select IOSF_MBI
	help
	  This is a debug driver, which gets the power states
	  of all Punit North Complex devices. The power states of
	  each device is exposed as part of the debugfs interface.
	  The current power state can be read from
	  /sys/kernel/debug/punit_atom/dev_power_state
```

## atomisp/6.11/drivers/media/Kconfig
```kconfig
# SPDX-License-Identifier: GPL-2.0-only
#
# Multimedia device configuration
#

#
# NOTE: CEC and Remote Controller support should not depend on MEDIA_SUPPORT
#

menuconfig MEDIA_SUPPORT
	tristate "Multimedia support"
	depends on HAS_IOMEM
	help
	  If you want to use media devices, including Webcams, Video grabber
	  devices and/or TV devices, V4L2 codecs, etc, enable this option
	  and other options below.

	  Additional info and docs are available on the web at
	  <https://linuxtv.org>

if MEDIA_SUPPORT

menu "Media drivers"

comment "Drivers filtered as selected at 'Filter media drivers'"
	depends on MEDIA_SUPPORT_FILTER

comment "Media drivers"

source "drivers/media/pci/Kconfig"
source "drivers/media/i2c/Kconfig"

endmenu

endif # MEDIA_SUPPORT
```

## atomisp/6.11/drivers/media/i2c/Kconfig
```kconfig
# SPDX-License-Identifier: GPL-2.0-only
#
# Multimedia Video device configuration
#

if VIDEO_DEV

comment "IR I2C driver auto-selected by 'Autoselect ancillary drivers'"
	depends on MEDIA_SUBDRV_AUTOSELECT && I2C && RC_CORE

config VIDEO_IR_I2C
	tristate "I2C module for IR" if !MEDIA_SUBDRV_AUTOSELECT || EXPERT
	depends on I2C && RC_CORE
	default y
	help
	  Most boards have an IR chip directly connected via GPIO. However,
	  some video boards have the IR connected via I2C bus.

	  If your board doesn't have an I2C IR chip, you may disable this
	  option.

	  In doubt, say Y.

#
# V4L2 I2C drivers that are related with Camera support
#

menuconfig VIDEO_CAMERA_SENSOR
	bool "Camera sensor devices"
	depends on MEDIA_CAMERA_SUPPORT && I2C
	select MEDIA_CONTROLLER
	select V4L2_FWNODE
	select VIDEO_V4L2_SUBDEV_API
	default y

if VIDEO_CAMERA_SENSOR

config VIDEO_APTINA_PLL
	tristate

config VIDEO_MT9M114
	tristate "onsemi MT9M114 sensor support"
	select V4L2_CCI_I2C
	select VIDEO_APTINA_PLL
	help
	  This is a Video4Linux2 sensor-level driver for the onsemi MT9M114
	  camera.

	  To compile this driver as a module, choose M here: the
	  module will be called mt9m114.

source "drivers/media/i2c/ccs/Kconfig"
source "drivers/media/i2c/et8ek8/Kconfig"

endif


endif # VIDEO_DEV
```

## atomisp/6.11/drivers/platform/x86/Kconfig
```kconfig
# SPDX-License-Identifier: GPL-2.0-only
#
# X86 Platform Specific Drivers
#

source "drivers/platform/x86/intel/Kconfig"
```

## atomisp/6.11/drivers/platform/x86/intel/Kconfig
```kconfig
# SPDX-License-Identifier: GPL-2.0-only
#
# Intel x86 Platform Specific Drivers
#

source "drivers/platform/x86/intel/atomisp2/Kconfig"

config INTEL_BYTCRC_PWRSRC
	tristate "Intel Bay Trail Crystal Cove power source driver"
	depends on INTEL_SOC_PMIC
	help
	  This option adds a power source driver for Crystal Cove PMICs
	  on Intel Bay Trail devices.

	  To compile this driver as a module, choose M here: the module
	  will be called intel_bytcrc_pwrsrc.
```

## atomisp/6.11/drivers/staging/media/atomisp/i2c/Kconfig
```kconfig
# SPDX-License-Identifier: GPL-2.0
#
# Kconfig for sensor drivers
#

config VIDEO_ATOMISP_MT9M114
	tristate "Aptina mt9m114 sensor support"
	depends on ACPI
	depends on I2C && VIDEO_DEV
	help
	  This is a Video4Linux2 sensor-level driver for the Micron
	  mt9m114 1.3 Mpixel camera.

	  mt9m114 is video camera sensor.

	  It currently only works with the atomisp driver.
```

## atomisp/6.12/drivers/platform/x86/intel/Kconfig
```kconfig
# SPDX-License-Identifier: GPL-2.0-only
#
# Intel x86 Platform Specific Drivers
#

source "drivers/platform/x86/intel/atomisp2/Kconfig"
source "drivers/platform/x86/intel/int1092/Kconfig"
source "drivers/platform/x86/intel/telemetry/Kconfig"
source "drivers/platform/x86/intel/wmi/Kconfig"

config INTEL_BXTWC_PMIC_TMU
	tristate "Intel Broxton Whiskey Cove TMU Driver"
	depends on INTEL_SOC_PMIC_BXTWC
	depends on MFD_INTEL_PMC_BXT
	select REGMAP
	help
	  Select this driver to use Intel Broxton Whiskey Cove PMIC TMU feature.
	  This driver enables the alarm wakeup functionality in the TMU unit of
	  Whiskey Cove PMIC.

config INTEL_BYTCRC_PWRSRC
	tristate "Intel Bay Trail Crystal Cove power source driver"
	depends on INTEL_SOC_PMIC
	help
	  This option adds a power source driver for Crystal Cove PMICs
	  on Intel Bay Trail devices.

	  To compile this driver as a module, choose M here: the module
	  will be called intel_bytcrc_pwrsrc.

config INTEL_CHTDC_TI_PWRBTN
	tristate "Intel Cherry Trail Dollar Cove TI power button driver"
	depends on INTEL_SOC_PMIC_CHTDC_TI
	depends on INPUT
	help
	  This option adds a power button driver for Dollar Cove TI
	  PMIC on Intel Cherry Trail devices.

	  To compile this driver as a module, choose M here: the module
	  will be called intel_chtdc_ti_pwrbtn.

config INTEL_ISHTP_ECLITE
	tristate "Intel ISHTP eclite controller Driver"
	depends on INTEL_ISH_HID
	depends on ACPI
	help
	  This driver is for accessing the PSE (Programmable Service Engine) -
	  an Embedded Controller like IP - using ISHTP (Integrated Sensor Hub
	  Transport Protocol) to get battery, thermal and UCSI (USB Type-C
	  Connector System Software Interface) related data from the platform.
	  Users who don't want to use discrete Embedded Controller on Intel's
	  Elkhartlake platform can leverage this integrated solution of
	  ECLite which is part of PSE subsystem.

	  To compile this driver as a module, choose M here: the module
	  will be called intel_ishtp_eclite.

config INTEL_MRFLD_PWRBTN
	tristate "Intel Merrifield Basin Cove power button driver"
	depends on INTEL_SOC_PMIC_MRFLD
	depends on INPUT
	help
	  This option adds a power button driver for Basin Cove PMIC
	  on Intel Merrifield devices.

	  To compile this driver as a module, choose M here: the module
	  will be called intel_mrfld_pwrbtn.

config INTEL_PUNIT_IPC
	tristate "Intel P-Unit IPC Driver"
	help
	  This driver provides support for Intel P-Unit Mailbox IPC mechanism,
	  which is used to bridge the communications between kernel and P-Unit.
```
